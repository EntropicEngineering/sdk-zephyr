
imu_spi: &spi3 {
	compatible = "nordic,nrf-spim";
	status = "okay";
	sck-pin = <32 /* P1.00 */>;
	miso-pin = <22>;
	mosi-pin = <25>;
	csn-pin = <24>;

    bno08x@0 {
        compatible = "hillcrest,bno08x";
        reg = <0>;
        spi-max-frequency = <2000000>; /* TODO: Need confirmation. */

        nrst-gpios  = <&gpio0 9 GPIO_ACTIVE_LOW>;
        intn-gpios  = <&gpio0 10 GPIO_ACTIVE_LOW>;
        wake-gpios  = <&gpio1 2 GPIO_ACTIVE_HIGH>;
        bootn-gpios = <&gpio1 1 GPIO_ACTIVE_LOW>;

        label = "BNO08X";
    };
};
