## boards/arm/ee_tp_nrf52840/Kconfig.board
```kconfig
# EE TP nRF52840 board configuration

config BOARD_EE_TP_NRF52840
	bool "EE TP nRF52840"
	depends on SOC_NRF52840_QIAA
```

## boards/arm/ee_tp_nrf52840/ee_tp_nrf52840_defconfig
```kconfig
CONFIG_SOC_SERIES_NRF52X=y
CONFIG_SOC_NRF52840_QIAA=y
CONFIG_BOARD_EE_TP_NRF52840=y

# Enable MPU
CONFIG_ARM_MPU=y

# Disable hardware reset line
CONFIG_GPIO_AS_PINRESET=n

# Not using NFC
CONFIG_NFCT_PINS_AS_GPIOS=y

# CPU crystal accuracy, options are 20, 30, 50 PPM
#CONFIG_CLOCK_CONTROL_NRF_K32SRC_20PPM=n
```

## drivers/sensor/bno080/Kconfig
```kconfig
# Copyright (c) 2021 Entropic Engg
#
# SPDX-License-Identifier: Apache-2.0

menuconfig BNO08X
	bool "BNO080 9-Axis Sensor"
	depends on SPI
	help
	  Enable SPI Based BNO080 9-Axis Sensor.
```

## dts/bindings/sensor/hillcrest,bno08x-spi.yaml
```yaml
# Copyright (c) 2021 Entropic Engg
# SPDX-License-Identifier: Apache-2.0

description: BNO08X Sensor Hub, accessed through SPI bus

compatible: "hillcrest,bno08x"

include: spi-device.yaml

properties:
    nrst-gpios:
      type: phandle-array
      required: true

    intn-gpios:
      type: phandle-array
      required: true

    wake-gpios:
      type: phandle-array
      required: true

    bootn-gpios:
      type: phandle-array
      required: true
      
```

## samples/sensor/bno080/boards/arm/ee_tp_nrf52840/Kconfig
```kconfig
# EE TP nRF52840 board configuration

config BOARD_ENABLE_DCDC
	bool "Enable DCDC mode"
	select SOC_DCDC_NRF52X
	default y
	depends on BOARD_EE_TP_NRF52840
```

## samples/sensor/bno080/boards/arm/ee_tp_nrf52840/Kconfig.defconfig
```kconfig
# EE TP nRF52840 board configuration

if BOARD_EE_TP_NRF52840

config BOARD
	default "ee_tp_nrf52840"

config BT_CTLR
	default BT

endif # BOARD_EE_TP_NRF52840
```

## samples/sensor/bno080/boards/arm/ee_tp_nrf52840/ee_tp_nrf52840_defconfig
```kconfig
CONFIG_SOC_SERIES_NRF52X=y
CONFIG_SOC_NRF52840_QIAA=y
CONFIG_BOARD_EE_TP_NRF52840=y

# Enable GPIO for power_hold line
CONFIG_GPIO=y

# Enable MPU
CONFIG_ARM_MPU=y

# Disable hardware reset line
CONFIG_GPIO_AS_PINRESET=n

# Not using NFC
CONFIG_NFCT_PINS_AS_GPIOS=y

# Full-swing clock
CONFIG_CLOCK_CONTROL_NRF_K32SRC_SYNTH=y
```

## subsys/storage/flash_map/Kconfig
```kconfig
# Flash map abstraction module

# Copyright (c) 2017 Nordic Semiconductor ASA
# SPDX-License-Identifier: Apache-2.0

#
# Flash map
#

menuconfig FLASH_MAP
	bool "Flash map abstraction module"
	depends on FLASH_HAS_DRIVER_ENABLED
	help
	  Enable support of flash map abstraction.

if FLASH_MAP

config FLASH_MAP_SHELL
	bool "Enable flash map shell interface"
	depends on SHELL
	help
	  This enables shell commands to list and test flash maps.

config FLASH_MAP_CUSTOM
	bool "Custom flash map description"
	help
	  This option enables custom flash map description.
	  User must provide such a description in place of default on
	  if had enabled this option.

config FLASH_MAP_DYNAMIC
	bool "Use a dynamic flash map description"
	help
	  Instead of using a static, pre-defined flash map which is
	  linked in the zephyr binary, this option allows the user
	  to specify a dynamic map in a certain area of "flash".
	  This option is never intended to be used without mcuboot
	  and only handles very specialized cases, i.e. mcuboot wants
	  to reconfigure the flash partitions. If unsure, say N.

config FLASH_AREA_CHECK_INTEGRITY
	bool "Enable flash check functions"
	select TINYCRYPT
	select TINYCRYPT_SHA256
	help
	  If enabled, there will be available the backend to check flash
	  integrity using SHA-256 verification algorithm.

endif
```
